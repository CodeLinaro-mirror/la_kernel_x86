## drivers/external_drivers/drivers/power/Kconfig
```kconfig
config BATTERY_MAX17042_EXT
	tristate "Maxim MAX17042/17047/17050/8997/8966 Fuel Gauge"
	depends on I2C
	select REGMAP_I2C
	help
	  MAX17042 is fuel-gauge systems for lithium-ion (Li+) batteries
	  in handheld and portable equipment. The MAX17042 is configured
	  to operate with a single lithium cell. MAX8997 and MAX8966 are
	  multi-function devices that include fuel gauages that are compatible
	  with MAX17042. This driver also supports max17047/50 chips which are
	  improved version of max17042.
```

## drivers/misc/bcm-lpm/Kconfig
```kconfig
config BCM_BT_LPM
	tristate "Broadcom Bluetooth Low Power Mode"
	depends on SERIAL_8250_MID || SERIAL_MFD_HSU_EXT
	default n
	help
	   Select this module for Broadcom Bluetooth low power management.
```

## drivers/misc/nxp-pn5xx/Kconfig
```kconfig
config NFC_NXP_PN5XX
	bool "NXP PN5XX based driver"
	depends on I2C
	select CRC_CCITT
	---help---
	  NXP PN5XX driver based on I2C.
	  This is a driver to provides I2C access to PN5xx NFC Controller devices
```

## drivers/misc/st21nfc/Kconfig
```kconfig
#
# Near Field Communication (NFC) devices
#

config ST21NFC_PLATFORM_DATA
	bool "ST Microelectronics ST21NFCA & ST21NFCB NFC Controller Driver"
	depends on I2C && SYSFS
	default n
	help
	  ST Microelectronics ST21NFCA & ST21NFCB Near Field Communication controller support.
```

## drivers/net/wireless/bcmdhd/Kconfig
```kconfig
config BCMDHD
        tristate "Broadcom wireless cards support"
        depends on WLAN
        ---help---
          This module adds support for wireless adapters based on
          Broadcom WLAN chipset.

	  If you choose to build a module, it will be called bcmdhd. Say M if
	  unsure.

choice
	prompt "---Enable chip specific options"
	depends on BCMDHD
	---help---
		Enable specific chip.

config BCMDHD_GENERIC_CHIP_SUPPORT
	bool "No chip specific options"
	depends on BCMDHD
	default y
	---help---
		Disable any chip specific options.

config BCM4339
        bool "BCM4339 support only"
        depends on BCMDHD
        ---help---
                Enable any BCM4339 specific options.

config BCM4354
	tristate "BCM4354 support"
	depends on BCMDHD
        ---help---
                Enable any BCM4354 specific options.

config BCM4343
	tristate "BCM4343W support"
	depends on BCMDHD
        ---help---
                Enable any BCM4343w specific options.
endchoice

config BCMDHD_SDIO
	bool "SDIO bus interface support"
	depends on BCMDHD && MMC

config BCMDHD_PCIE
	bool "PCIe bus interface support"
	depends on BCMDHD && PCI && !BCMDHD_SDIO

choice
	prompt "---Enable platform specific options"
	depends on BCMDHD
	---help---
		Enable specific platform.

config BCMDHD_GENERIC_PLATFORM_SUPPORT
	bool "No platform specific options"
	depends on BCMDHD
	---help---
		Disable any platform specific options.

config IMX_PLATFORM
	bool "Enable NXP iMX specific flags"
	depends on BCMDHD
	default y
	---help---
	        Enable NXP iMX specific flags

config INTEL_PLATFORM
	bool "Enable Intel specific flags"
	depends on BCMDHD
	---help---
	        Enable Intel specific flags
endchoice

config BCMDHD_FW_PATH
	depends on BCMDHD
	string "Firmware path"
	default "/system/vendor/firmware/fw_bcmdhd.bin"
	---help---
	  Path to the firmware file.

config BCMDHD_NVRAM_PATH
	depends on BCMDHD
	string "NVRAM path"
	default "/system/etc/wifi/bcmdhd.cal"
	---help---
	  Path to the calibration file.

config BCMDHD_WEXT
	bool "Enable WEXT support"
	depends on BCMDHD && CFG80211 = n
	select WIRELESS_EXT
	select WEXT_PRIV
	help
	  Enables WEXT support

config DHD_USE_STATIC_BUF
	bool "Enable memory preallocation"
	depends on BCMDHD
	default n
	---help---
	  Use memory preallocated in platform

config DHD_USE_SCHED_SCAN
	bool "Use CFG80211 sched scan"
	depends on BCMDHD && CFG80211
	default n
	---help---
	  Use CFG80211 sched scan
```
